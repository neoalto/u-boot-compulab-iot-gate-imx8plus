## board/compulab/iot-gate-imx8plus/Kconfig
```kconfig
if TARGET_IOT_GATE_IMX8PLUS

config SYS_BOARD
	default "iot-gate-imx8plus"

config SYS_VENDOR
	default "compulab"

config SYS_CONFIG_NAME
	default "iot-gate-imx8plus"

config DEFAULT_DEVICE_TREE
	default "iot-gate-imx8plus"

config DEFAULT_FDT_FILE
	default "iot-gate-imx8plus.dtb"

config SYS_I2C_EEPROM_BUS
	int
	default 1

config SYS_I2C_EEPROM_ADDR
	hex
	default 0x50

config SYS_I2C_EEPROM_ADDR_LEN
	int
	default 1

config SYS_I2C_EEPROM_BUS_SB
	int
	default 1

config SYS_I2C_EEPROM_ADDR_SB
	hex
	default 0x54

choice
	prompt "IOT-GATE-IMX8PLUS D2 LPDDR4 timing"
	default IOT_GATE_IMX8PLUS_D2_01061010
	help
	  Select the 2 GiB LPDDR4 timing table fitted to the module.
	  The default table is the CompuLab D2 timing used for Samsung,
	  Nanya and Kingston IDs. Select the ISSI table only for D2 SOMs
	  populated with the ISSI LPDDR4 part identified as 0x13000210.

config IOT_GATE_IMX8PLUS_D2_01061010
	bool "D2 2GiB Samsung/Nanya/Kingston-compatible timing"

config IOT_GATE_IMX8PLUS_D2_ISSI
	bool "D2 2GiB ISSI 0x13000210 timing"

endchoice

endif
```

## configs/iot-gate-imx8plus_d2_defconfig
```kconfig
CONFIG_ARM=y
CONFIG_ARCH_IMX8M=y
CONFIG_TEXT_BASE=0x40200000
CONFIG_SYS_MALLOC_LEN=0x2000000
CONFIG_SPL_GPIO=y
CONFIG_SPL_LIBCOMMON_SUPPORT=y
CONFIG_SPL_LIBGENERIC_SUPPORT=y
CONFIG_ENV_SIZE=0x4000
CONFIG_ENV_OFFSET=0x3F0000
CONFIG_DM_GPIO=y
CONFIG_DEFAULT_DEVICE_TREE="iot-gate-imx8plus"
CONFIG_TARGET_IOT_GATE_IMX8PLUS=y
CONFIG_SYS_MONITOR_LEN=524288
CONFIG_SPL_MMC=y
CONFIG_SPL_SERIAL=y
CONFIG_SPL_DRIVERS_MISC=y
CONFIG_SPL_STACK=0x960000
CONFIG_SPL_TEXT_BASE=0x920000
CONFIG_SPL_HAS_BSS_LINKER_SECTION=y
CONFIG_SPL_BSS_START_ADDR=0x98fc00
CONFIG_SPL_BSS_MAX_SIZE=0x400
CONFIG_SYS_BOOTM_LEN=0x2000000
CONFIG_SYS_LOAD_ADDR=0x40480000
CONFIG_SPL=y
CONFIG_ENV_OFFSET_REDUND=0x3F0000
CONFIG_SPL_IMX_ROMAPI_LOADADDR=0x48000000
CONFIG_FIT=y
CONFIG_FIT_EXTERNAL_OFFSET=0x3000
CONFIG_SPL_LOAD_FIT=y
CONFIG_BOOTCOMMAND="run ab_boot"
CONFIG_DEFAULT_FDT_FILE="iot-gate-imx8plus.dtb"
CONFIG_SYS_CBSIZE=2048
CONFIG_SYS_PBSIZE=2074
# CONFIG_BOARD_INIT is not set
CONFIG_BOARD_LATE_INIT=y
CONFIG_SPL_MAX_SIZE=0x26000
CONFIG_SPL_BOARD_INIT=y
CONFIG_SPL_BOOTROM_SUPPORT=y
CONFIG_SPL_SYS_MALLOC_SIMPLE=y
# CONFIG_SPL_SHARES_INIT_SP_ADDR is not set
CONFIG_SPL_HAVE_INIT_STACK=y
CONFIG_SPL_SYS_MALLOC=y
CONFIG_SPL_HAS_CUSTOM_MALLOC_START=y
CONFIG_SPL_CUSTOM_SYS_MALLOC_ADDR=0x42200000
CONFIG_SPL_SYS_MALLOC_SIZE=0x80000
CONFIG_SPL_SYS_MMCSD_RAW_MODE=y
CONFIG_SYS_MMCSD_RAW_MODE_U_BOOT_SECTOR=0x300
CONFIG_SPL_I2C=y
CONFIG_SPL_POWER=y
CONFIG_SPL_WATCHDOG=y
CONFIG_SYS_PROMPT="u-boot=> "
CONFIG_BOOTCOUNT_ENV=y
CONFIG_BOOTCOUNT_LIMIT=y
CONFIG_HUSH_PARSER=y
# CONFIG_CMD_BOOTEFI is not set
# CONFIG_CMD_EXPORTENV is not set
# CONFIG_CMD_IMPORTENV is not set
# CONFIG_CMD_CRC32 is not set
CONFIG_CMD_BOOTI=y
CONFIG_CMD_CLK=y
CONFIG_CMD_GPIO=y
CONFIG_CMD_I2C=y
CONFIG_CMD_MMC=y
CONFIG_CMD_PART=y
CONFIG_CMD_FS_GENERIC=y
CONFIG_CMD_EXT4=y
CONFIG_CMD_CACHE=y
CONFIG_CMD_REGULATOR=y
CONFIG_CMD_EXT4_WRITE=n
CONFIG_PARTITION_UUIDS=y
CONFIG_PARTITION_TYPE_GUID=y
CONFIG_EFI_PARTITION=y
CONFIG_DOS_PARTITION=y
CONFIG_FS_FAT=y
CONFIG_FAT_WRITE=n
CONFIG_CMD_FAT=y
CONFIG_CMD_WDT=y
CONFIG_CMD_SETEXPR=y
CONFIG_CMD_ENV_FLAGS=y
CONFIG_OF_CONTROL=y
CONFIG_SPL_OF_CONTROL=y
CONFIG_ENV_OVERWRITE=y
CONFIG_ENV_IS_IN_MMC=y
CONFIG_ENV_REDUNDANT=y
CONFIG_ENV_MMC_EMMC_HW_PARTITION=1
CONFIG_ENV_RELOC_GD_ENV_ADDR=y
CONFIG_ENV_MMC_DEVICE_INDEX=2
CONFIG_ENV_WRITEABLE_LIST=y
CONFIG_ENV_ACCESS_IGNORE_FORCE=y
CONFIG_SPL_DM=y
CONFIG_CLK_COMPOSITE_CCF=y
CONFIG_CLK_IMX8MP=y
CONFIG_MXC_GPIO=y
CONFIG_DM_I2C=y
CONFIG_SUPPORT_EMMC_RPMB=y
CONFIG_SUPPORT_EMMC_BOOT=y
CONFIG_MMC_IO_VOLTAGE=y
CONFIG_MMC_UHS_SUPPORT=y
CONFIG_MMC_HS400_ES_SUPPORT=y
CONFIG_MMC_HS400_SUPPORT=y
CONFIG_FSL_USDHC=y
CONFIG_PINCTRL=y
CONFIG_SPL_PINCTRL=y
CONFIG_PINCTRL_IMX8M=y
CONFIG_POWER_DOMAIN=y
CONFIG_IMX8M_POWER_DOMAIN=y
CONFIG_IMX8MP_HSIOMIX_BLKCTRL=y
CONFIG_DM_PMIC=y
CONFIG_DM_PMIC_PCA9450=y
CONFIG_SPL_DM_PMIC_PCA9450=y
CONFIG_DM_REGULATOR=y
CONFIG_DM_REGULATOR_PCA9450=y
CONFIG_DM_REGULATOR_FIXED=y
CONFIG_DM_SERIAL=y
CONFIG_MXC_UART=y
CONFIG_SYSRESET=y
CONFIG_SPL_SYSRESET=y
CONFIG_SYSRESET_PSCI=y
CONFIG_SYSRESET_WATCHDOG=y
CONFIG_IMX_WATCHDOG=y
CONFIG_WDT=y
# CONFIG_NET is not set
# CONFIG_USB is not set
# CONFIG_VIDEO is not set
# CONFIG_OPTEE is not set
# CONFIG_TEE is not set
# CONFIG_EFI_LOADER is not set
# CONFIG_SPL_SHA512 is not set
CONFIG_FSL_CAAM=y
CONFIG_FSL_CAAM_JR_NTZ_ACCESS=y
CONFIG_OF_BOARD_SETUP=y
```
